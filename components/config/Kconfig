## components/config/Kconfig
```kconfig
menu "Mosaico Deck"

    choice FBOX_BOARD_REV
        prompt "ESP-Mosaico CoreBoard revision (FALLBACK only)"
        default FBOX_BOARD_V10
        help
            WARNING: Under normal circumstances **you do not need to touch this**: the board
            revision is auto-detected from the hardware revision word in the chip eFuse
            (board::Init(); the official BSP's bsp_board_variant_get() does the same).
            This option is only a fallback for when the eFuse cannot be read or holds an
            unsupported value.

            Why you cannot rely on this option: LCD_RST / LCD_SCL are **swapped** between
            the two revisions, and choosing wrong means the QSPI clock lands on the reset
            pin and the panel never receives a valid command -- and since QSPI is a
            **write-only bus**, the ESP side is completely unaware: the driver returns
            ESP_OK the whole way, and you end up with a screen that "initialized
            successfully but is black the entire time". This project actually hit this.

            For reference only, the differences between the two revisions:
              V1.0: LCD_RST=GPIO42, LCD_SCL=GPIO44
              V1.2: LCD_RST=GPIO44, LCD_SCL=GPIO42
            Choose wrong and the panel will not light up. Please confirm against the
            silkscreen on the mainboard.

            The I2C pins **do not need to be selected here**: at startup the firmware
            automatically scans both groups GPIO0/1 and GPIO56/3 and picks whichever group
            has devices (this particular board was measured to use GPIO56/3, different
            from the GPIO0/1 written in the official V1.0 documentation, so leaving it to
            the probe is more reliable).

        config FBOX_BOARD_V10
            bool "V1.0  (orange status LED, LCD_RST=42/SCL=44)"

        config FBOX_BOARD_V12
            bool "V1.2  (no status LED, LCD_RST=44/SCL=42)"
    endchoice

    config FBOX_DISPLAY_PCLK_MHZ
        int "QSPI pixel clock (MHz)"
        range 20 120
        default 60
        help
            **Default 60, not the official 40, and not the 80 it could run at.**

            Reason: the panel's refresh rate (TE measured about 58.5 Hz) is the real
            ceiling of this system. Feeding a full 60 Hz needs about 54 MHz, so 60 MHz is
            just enough and anything higher is pure waste -- pushing faster than the panel
            does not make it smoother, it only tears.

            Moreover, **a high clock has a cost**: the link goes through the GPIO matrix
            and the drive strength is required by the official code to be set to the
            weakest step (`FBOX_LCD_DRIVE_CAP`, to reduce EMI); at 80 MHz the edges do not
            have time to settle and occasional bit errors occur -- the symptom is "one
            band flashes a different color", and since QSPI is a write-only bus, the host
            side sees no error at all. This project actually hit this pitfall.

            If you see corrupted or wrong-colored output, turn it down; if you want to play
            it safe, use 40 like the official code (at the cost of dropping to about
            44 fps).

    config FBOX_LCD_DRIVE_CAP
        int "QSPI bus pin drive strength (0-3)"
        range 0 3
        default 2
        help
            GPIO drive strength of the CO5300's five lines, SCL and DATA0-DATA3.
            0 = weakest, 3 = strongest.

            The official BSP defaults to **0** (weakest) in order to lower the edge rate
            and reduce EMI, which is good for Wi-Fi/BLE coexistence; the official comment
            also states "turn it up if signal integrity fails at high clock".

            Here the default is **2** (medium): it leaves enough setup-time margin at
            60 MHz, at the cost of somewhat more EMI than the weakest step. If your board
            insists on running at 80 MHz you can try 3; conversely, to save power or reduce
            EMI, set it to 0 and lower PCLK to 40.
            Corresponds to the official Kconfig's BSP_LCD_QSPI_DRIVE_CAP.

endmenu
```
